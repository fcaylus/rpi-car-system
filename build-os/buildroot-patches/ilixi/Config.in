## build-os/buildroot-patches/ilixi/Config.in
```kconfig
config BR2_PACKAGE_ILIXI
	bool "ilixi"
	depends on BR2_PACKAGE_DIRECTFB
	select BR2_PACKAGE_LIBXML2
	select BR2_PACKAGE_LIBSIGC
	help
	  http://www.ilixi.org/
```

## build-os/buildroot-patches/libmediainfo/Config.in
```kconfig
config BR2_PACKAGE_LIBMEDIAINFO
	bool "libmediainfo"
	select BR2_PACKAGE_LIBZEN
	select BR2_PACKAGE_ZLIB
```

## build-os/buildroot-patches/libvlc/Config.in
```kconfig
config BR2_PACKAGE_LIBVLC
	bool "libvlc"
	depends on (BR2_UCLIBC_VERSION_SNAPSHOT || BR2_UCLIBC_VERSION_NG || BR2_TOOLCHAIN_USES_GLIBC) # spawn.h
	depends on BR2_INSTALL_LIBSTDCPP
	depends on BR2_USE_WCHAR
	depends on BR2_TOOLCHAIN_HAS_THREADS
	depends on BR2_TOOLCHAIN_HEADERS_AT_LEAST_3_7

	select BR2_PACKAGE_DBUS
	select BR2_PACKAGE_LIBOGG
	select BR2_PACKAGE_LIBMATROSKA
	select BR2_PACKAGE_LIBMODPLUG
	select BR2_PACKAGE_LIBMAD
	select BR2_PACKAGE_FFMPEG
	select BR2_PACKAGE_FAAD2
	select BR2_PACKAGE_LIBVPX
	select BR2_PACKAGE_TWOLAME
	select BR2_PACKAGE_FDK_AAC
	select BR2_PACKAGE_FLAC
	select BR2_PACKAGE_LIBMPEG2
	select BR2_PACKAGE_LIBVORBIS
	select BR2_PACKAGE_LIBPNG
	select BR2_PACKAGE_LIBJPEG
	select BR2_PACKAGE_X264
	select BR2_PACKAGE_LIBASS
	select BR2_PACKAGE_FREETYPE
	select BR2_PACKAGE_LIBFRIBIDI
	select BR2_PACKAGE_FONTCONFIG
	select BR2_PACKAGE_LIBSVG
	select BR2_PACKAGE_LIBRSVG
	select BR2_PACKAGE_ALSA_LIB
	select BR2_PACKAGE_JACK2
	select BR2_PACKAGE_LIBSAMPLERATE
	select BR2_PACKAGE_LIBXML2
	select BR2_PACKAGE_TAGLIB

	help
	  VLC is a free and open source cross-platform multimedia player
	  and framework that plays most multimedia files as well as DVD,
	  Audio CD, VCD, and various streaming protocols.

	  http://www.videolan.org/vlc/

comment "libvlc needs a uclibc snapshot, uclibc-ng or (e)glibc toolchain w/ C++, wchar, threads, headers >= 3.7"
	depends on !(BR2_UCLIBC_VERSION_SNAPSHOT || BR2_UCLIBC_VERSION_NG || BR2_TOOLCHAIN_USES_GLIBC) \
		|| !BR2_INSTALL_LIBSTDCPP || !BR2_USE_WCHAR \
		|| !BR2_TOOLCHAIN_HAS_THREADS || !BR2_TOOLCHAIN_HEADERS_AT_LEAST_3_7
```

## build-os/buildroot-patches/rpi-car-system/Config.in
```kconfig
config BR2_PACKAGE_RPI_CAR_SYSTEM
	bool "rpi-car-system"
	depends on BR2_PACKAGE_QT5
	select BR2_PACKAGE_EUDEV
	select BR2_PACKAGE_NCURSES
	select BR2_PACKAGE_LIBMEDIAINFO
	select BR2_PACKAGE_LIBARCHIVE
	select BR2_PACKAGE_VLC_QT
```

## build-os/buildroot-patches/vlc-qt/Config.in
```kconfig
config BR2_PACKAGE_VLC_QT
	bool "vlc-qt"
	depends on BR2_PACKAGE_QT5
	select BR2_PACKAGE_LIBVLC
```
